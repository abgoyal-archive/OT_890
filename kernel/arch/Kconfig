## kernel/drivers/staging/meilhaus/Kconfig
```kconfig
# Copyright Statement:
#
# This software/firmware and related documentation ("MediaTek Software") are
# protected under relevant copyright laws. The information contained herein
# is confidential and proprietary to MediaTek Inc. and/or its licensors.
# Without the prior written permission of MediaTek inc. and/or its licensors,
# any reproduction, modification, use or disclosure of MediaTek Software,
# and information contained herein, in whole or in part, shall be strictly prohibited.

# MediaTek Inc. (C) 2010. All rights reserved.
#
# BY OPENING THIS FILE, RECEIVER HEREBY UNEQUIVOCALLY ACKNOWLEDGES AND AGREES
# THAT THE SOFTWARE/FIRMWARE AND ITS DOCUMENTATIONS ("MEDIATEK SOFTWARE")
# RECEIVED FROM MEDIATEK AND/OR ITS REPRESENTATIVES ARE PROVIDED TO RECEIVER ON
# AN "AS-IS" BASIS ONLY. MEDIATEK EXPRESSLY DISCLAIMS ANY AND ALL WARRANTIES,
# EXPRESS OR IMPLIED, INCLUDING BUT NOT LIMITED TO THE IMPLIED WARRANTIES OF
# MERCHANTABILITY, FITNESS FOR A PARTICULAR PURPOSE OR NONINFRINGEMENT.
# NEITHER DOES MEDIATEK PROVIDE ANY WARRANTY WHATSOEVER WITH RESPECT TO THE
# SOFTWARE OF ANY THIRD PARTY WHICH MAY BE USED BY, INCORPORATED IN, OR
# SUPPLIED WITH THE MEDIATEK SOFTWARE, AND RECEIVER AGREES TO LOOK ONLY TO SUCH
# THIRD PARTY FOR ANY WARRANTY CLAIM RELATING THERETO. RECEIVER EXPRESSLY ACKNOWLEDGES
# THAT IT IS RECEIVER'S SOLE RESPONSIBILITY TO OBTAIN FROM ANY THIRD PARTY ALL PROPER LICENSES
# CONTAINED IN MEDIATEK SOFTWARE. MEDIATEK SHALL ALSO NOT BE RESPONSIBLE FOR ANY MEDIATEK
# SOFTWARE RELEASES MADE TO RECEIVER'S SPECIFICATION OR TO CONFORM TO A PARTICULAR
# STANDARD OR OPEN FORUM. RECEIVER'S SOLE AND EXCLUSIVE REMEDY AND MEDIATEK'S ENTIRE AND
# CUMULATIVE LIABILITY WITH RESPECT TO THE MEDIATEK SOFTWARE RELEASED HEREUNDER WILL BE,
# AT MEDIATEK'S OPTION, TO REVISE OR REPLACE THE MEDIATEK SOFTWARE AT ISSUE,
# OR REFUND ANY SOFTWARE LICENSE FEES OR SERVICE CHARGE PAID BY RECEIVER TO
# MEDIATEK FOR SUCH MEDIATEK SOFTWARE AT ISSUE.


#
# Meilhaus configuration
#

menuconfig MEILHAUS
	tristate "Meilhaus support"
	depends on m
	---help---
	  If you have a Meilhaus card, say Y (or M) here.

	  You need both this driver, and the driver for the particular
	  data collection card.

	  To compile this driver as a module, choose M here. The module will
	  be called memain.

if MEILHAUS

config ME0600
	tristate "Meilhaus ME-600 support"
	default n
	depends on PCI && m
	help
	  This driver supports the Meilhaus ME-600 family of boards
	  that do data collection and multipurpose I/O.

	  To compile this driver as a module, choose M here: the module
	  will be called me0600.

config ME0900
	tristate "Meilhaus ME-900 support"
	default n
	depends on PCI && m
	help
	  This driver supports the Meilhaus ME-900 family of boards
	  that do data collection and multipurpose I/O.

	  To compile this driver as a module, choose M here: the module
	  will be called me0900.

config ME1000
	tristate "Meilhaus ME-1000 support"
	default n
	depends on PCI && m
	help
	  This driver supports the Meilhaus ME-1000 family of boards
	  that do data collection and multipurpose I/O.

	  To compile this driver as a module, choose M here: the module
	  will be called me1000.

config ME1400
	tristate "Meilhaus ME-1400 support"
	default n
	depends on PCI && m
	help
	  This driver supports the Meilhaus ME-1400 family of boards
	  that do data collection and multipurpose I/O.

	  To compile this driver as a module, choose M here: the module
	  will be called me1400.

config ME1600
	tristate "Meilhaus ME-1600 support"
	default n
	depends on PCI && m
	help
	  This driver supports the Meilhaus ME-1600 family of boards
	  that do data collection and multipurpose I/O.

	  To compile this driver as a module, choose M here: the module
	  will be called me1600.

config ME4600
	tristate "Meilhaus ME-4600 support"
	default n
	depends on PCI && m
	help
	  This driver supports the Meilhaus ME-4600 family of boards
	  that do data collection and multipurpose I/O.

	  To compile this driver as a module, choose M here: the module
	  will be called me4600.

config ME6000
	tristate "Meilhaus ME-6000 support"
	default n
	depends on PCI && m
	help
	  This driver supports the Meilhaus ME-6000 family of boards
	  that do data collection and multipurpose I/O.

	  To compile this driver as a module, choose M here: the module
	  will be called me6000.

config ME8100
	tristate "Meilhaus ME-8100 support"
	default n
	depends on PCI && m
	help
	  This driver supports the Meilhaus ME-8100 family of boards
	  that do data collection and multipurpose I/O.

	  To compile this driver as a module, choose M here: the module
	  will be called me8100.

config ME8200
	tristate "Meilhaus ME-8200 support"
	default n
	depends on PCI && m
	help
	  This driver supports the Meilhaus ME-8200 family of boards
	  that do data collection and multipurpose I/O.

	  To compile this driver as a module, choose M here: the module
	  will be called me8200.

config MEDUMMY
	tristate "Meilhaus dummy driver"
	default n
	depends on PCI && m
	help
	  This provides a dummy driver for the Meilhaus driver package

	  To compile this driver as a module, choose M here: the module
	  will be called medummy.

endif # MEILHAUS
```

## kernel/drivers/uio/Kconfig
```kconfig
# Copyright Statement:
#
# This software/firmware and related documentation ("MediaTek Software") are
# protected under relevant copyright laws. The information contained herein
# is confidential and proprietary to MediaTek Inc. and/or its licensors.
# Without the prior written permission of MediaTek inc. and/or its licensors,
# any reproduction, modification, use or disclosure of MediaTek Software,
# and information contained herein, in whole or in part, shall be strictly prohibited.

# MediaTek Inc. (C) 2010. All rights reserved.
#
# BY OPENING THIS FILE, RECEIVER HEREBY UNEQUIVOCALLY ACKNOWLEDGES AND AGREES
# THAT THE SOFTWARE/FIRMWARE AND ITS DOCUMENTATIONS ("MEDIATEK SOFTWARE")
# RECEIVED FROM MEDIATEK AND/OR ITS REPRESENTATIVES ARE PROVIDED TO RECEIVER ON
# AN "AS-IS" BASIS ONLY. MEDIATEK EXPRESSLY DISCLAIMS ANY AND ALL WARRANTIES,
# EXPRESS OR IMPLIED, INCLUDING BUT NOT LIMITED TO THE IMPLIED WARRANTIES OF
# MERCHANTABILITY, FITNESS FOR A PARTICULAR PURPOSE OR NONINFRINGEMENT.
# NEITHER DOES MEDIATEK PROVIDE ANY WARRANTY WHATSOEVER WITH RESPECT TO THE
# SOFTWARE OF ANY THIRD PARTY WHICH MAY BE USED BY, INCORPORATED IN, OR
# SUPPLIED WITH THE MEDIATEK SOFTWARE, AND RECEIVER AGREES TO LOOK ONLY TO SUCH
# THIRD PARTY FOR ANY WARRANTY CLAIM RELATING THERETO. RECEIVER EXPRESSLY ACKNOWLEDGES
# THAT IT IS RECEIVER'S SOLE RESPONSIBILITY TO OBTAIN FROM ANY THIRD PARTY ALL PROPER LICENSES
# CONTAINED IN MEDIATEK SOFTWARE. MEDIATEK SHALL ALSO NOT BE RESPONSIBLE FOR ANY MEDIATEK
# SOFTWARE RELEASES MADE TO RECEIVER'S SPECIFICATION OR TO CONFORM TO A PARTICULAR
# STANDARD OR OPEN FORUM. RECEIVER'S SOLE AND EXCLUSIVE REMEDY AND MEDIATEK'S ENTIRE AND
# CUMULATIVE LIABILITY WITH RESPECT TO THE MEDIATEK SOFTWARE RELEASED HEREUNDER WILL BE,
# AT MEDIATEK'S OPTION, TO REVISE OR REPLACE THE MEDIATEK SOFTWARE AT ISSUE,
# OR REFUND ANY SOFTWARE LICENSE FEES OR SERVICE CHARGE PAID BY RECEIVER TO
# MEDIATEK FOR SUCH MEDIATEK SOFTWARE AT ISSUE.


menuconfig UIO
	tristate "Userspace I/O drivers"
	depends on !S390
	default n
	help
	  Enable this to allow the userspace driver core code to be
	  built.  This code allows userspace programs easy access to
	  kernel interrupts and memory locations, allowing some drivers
	  to be written in userspace.  Note that a small kernel driver
	  is also required for interrupt handling to work properly.

	  If you don't know what to do here, say N.

if UIO

config UIO_CIF
	tristate "generic Hilscher CIF Card driver"
	depends on PCI
	default n
	help
	  Driver for Hilscher CIF DeviceNet and Profibus cards.  This
	  driver requires a userspace component that handles all of the
	  heavy lifting and can be found at:
	  	http://www.osadl.org/projects/downloads/UIO/user/cif-*

	  To compile this driver as a module, choose M here: the module
	  will be called uio_cif.

config UIO_PDRV
	tristate "Userspace I/O platform driver"
	help
	  Generic platform driver for Userspace I/O devices.

	  If you don't know what to do here, say N.

config UIO_PDRV_GENIRQ
	tristate "Userspace I/O platform driver with generic IRQ handling"
	help
	  Platform driver for Userspace I/O devices, including generic
	  interrupt handling code. Shared interrupts are not supported.

	  This kernel driver requires that the matching userspace driver
	  handles interrupts in a special way. Userspace is responsible
	  for acknowledging the hardware device if needed, and re-enabling
	  interrupts in the interrupt controller using the write() syscall.

	  If you don't know what to do here, say N.

config UIO_SMX
	tristate "SMX cryptengine UIO interface"
	default n
	help
	  Userspace IO interface to the Cryptography engine found on the
	  Nias Digital SMX boards.  These will be available from Q4 2008
	  from http://www.niasdigital.com.  The userspace part of this
	  driver will be released under the GPL at the same time as the
	  hardware and will be able to be downloaded from the same site.

	  If you compile this as a module, it will be called uio_smx.

config UIO_SERCOS3
	tristate "Automata Sercos III PCI card driver"
	default n
	help
	  Userspace I/O interface for the Sercos III PCI card from
	  Automata GmbH. The userspace part of this driver will be
	  available for download from the Automata GmbH web site.

	  Automata GmbH:        http://www.automataweb.com
	  Sercos III interface: http://www.sercos.com

	  If you compile this as a module, it will be called uio_sercos3.

endif
```

## kernel/drivers/video/mtk/Kconfig
```kconfig
# Copyright Statement:
#
# This software/firmware and related documentation ("MediaTek Software") are
# protected under relevant copyright laws. The information contained herein
# is confidential and proprietary to MediaTek Inc. and/or its licensors.
# Without the prior written permission of MediaTek inc. and/or its licensors,
# any reproduction, modification, use or disclosure of MediaTek Software,
# and information contained herein, in whole or in part, shall be strictly prohibited.

# MediaTek Inc. (C) 2010. All rights reserved.
#
# BY OPENING THIS FILE, RECEIVER HEREBY UNEQUIVOCALLY ACKNOWLEDGES AND AGREES
# THAT THE SOFTWARE/FIRMWARE AND ITS DOCUMENTATIONS ("MEDIATEK SOFTWARE")
# RECEIVED FROM MEDIATEK AND/OR ITS REPRESENTATIVES ARE PROVIDED TO RECEIVER ON
# AN "AS-IS" BASIS ONLY. MEDIATEK EXPRESSLY DISCLAIMS ANY AND ALL WARRANTIES,
# EXPRESS OR IMPLIED, INCLUDING BUT NOT LIMITED TO THE IMPLIED WARRANTIES OF
# MERCHANTABILITY, FITNESS FOR A PARTICULAR PURPOSE OR NONINFRINGEMENT.
# NEITHER DOES MEDIATEK PROVIDE ANY WARRANTY WHATSOEVER WITH RESPECT TO THE
# SOFTWARE OF ANY THIRD PARTY WHICH MAY BE USED BY, INCORPORATED IN, OR
# SUPPLIED WITH THE MEDIATEK SOFTWARE, AND RECEIVER AGREES TO LOOK ONLY TO SUCH
# THIRD PARTY FOR ANY WARRANTY CLAIM RELATING THERETO. RECEIVER EXPRESSLY ACKNOWLEDGES
# THAT IT IS RECEIVER'S SOLE RESPONSIBILITY TO OBTAIN FROM ANY THIRD PARTY ALL PROPER LICENSES
# CONTAINED IN MEDIATEK SOFTWARE. MEDIATEK SHALL ALSO NOT BE RESPONSIBLE FOR ANY MEDIATEK
# SOFTWARE RELEASES MADE TO RECEIVER'S SPECIFICATION OR TO CONFORM TO A PARTICULAR
# STANDARD OR OPEN FORUM. RECEIVER'S SOLE AND EXCLUSIVE REMEDY AND MEDIATEK'S ENTIRE AND
# CUMULATIVE LIABILITY WITH RESPECT TO THE MEDIATEK SOFTWARE RELEASED HEREUNDER WILL BE,
# AT MEDIATEK'S OPTION, TO REVISE OR REPLACE THE MEDIATEK SOFTWARE AT ISSUE,
# OR REFUND ANY SOFTWARE LICENSE FEES OR SERVICE CHARGE PAID BY RECEIVER TO
# MEDIATEK FOR SUCH MEDIATEK SOFTWARE AT ISSUE.
#
# The following software/firmware and/or related documentation ("MediaTek Software")
# have been modified by MediaTek Inc. All revisions are subject to any receiver's
# applicable license agreements with MediaTek Inc.


config FB_MT6516
	bool "MediaTek (MT6516) LCD Driver"
	depends on FB && ARCH_MT6516
	select FB_CFB_FILLRECT
	select FB_CFB_COPYAREA
	select FB_CFB_IMAGEBLIT
	select FB_SOFT_CURSOR
	---help---
	  Framebuffer for MT6516

config FB_MT6516_SUPPORT_ASSERTION_LAYER
	bool "Support MT6516 Assertion Layer for AEE"
	depends on FB_MT6516
    select FONT_8x16
	default y
	---help---
	  Support MT6516 Assertion Layer for AEE

config FB_MT6516_EVB_USE_HVGA_LCM
	bool "Use MagnaChip TA7601 HVGA LCM on EVB"
	depends on FB_MT6516 && MT6516_EVB_BOARD
	default n
	---help---
	  Use MagnaChip TA7601 HVGA LCM on EVB
	  
config FB_MT6516_SIMULATE_MULTIPLE_RESOLUTIONS_ON_OPPO
	bool "Simulate multiple resolutions on MTK OPPO reference phone"
	depends on FB_MT6516 && MT6516_OPPO_BOARD
	default n
	---help---
	  Simulate multiple resolutions on MTK OPPO reference phone

config FB_MT6516_OPPO_SIMUL_WIDTH
	int "OPPO simulation width"
	depends on FB_MT6516_SIMULATE_MULTIPLE_RESOLUTIONS_ON_OPPO
	default 320
	---help---
	  OPPO simulation width

config FB_MT6516_OPPO_SIMUL_HEIGHT
	int "OPPO simulation height"
	depends on FB_MT6516_SIMULATE_MULTIPLE_RESOLUTIONS_ON_OPPO
	default 480
	---help---
	  OPPO simulation height
```
